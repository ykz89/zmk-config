#define XXX &none
#define ___ &trans

#include "aliases.dtsi"


ZMK_LAYER(base,
    //  ╭────────╮ ╭─────────────┬─────────────┬─────────────┬─────────────┬─────────────╮ ╭────────╮ ╭─────────────┬─────────────┬─────────────┬─────────────┬─────────────╮ ╭────────╮
          X_LT_0     &kp Q         &kp W         &kp F         &kp P         &kp B           X_MT_0     &kp J         &kp L         &kp U         &kp Y         &kp SQT         X_RT_0
    //  ├────────┤ ├─────────────┼─────────────┼─────────────┼─────────────┼─────────────┤ ├────────┤ ├─────────────┼─────────────┼─────────────┼─────────────┼─────────────┤ ├────────┤
          X_LM_0     &hml LSHIFT A &hml LALT R   &hml LCTRL S  &hml LGUI T   &kp G           X_MM_0     &kp M         &hmr RGUI N   &hmr RCTRL E  &hmr RALT I   &hmr RSHIFT O   X_RM_0
    //  ├────────┤ ├─────────────┼─────────────┼─────────────┼─────────────┼─────────────┤ ├────────┤ ├─────────────┼─────────────┼─────────────┼─────────────┼─────────────┤ ├────────┤
          X_LB_0     &kp Z         &kp X         &kp C         &kp D         &kp V           X_MB_0     &kp K         &kp H         &kp COMMA     &kp DOT       &kp SLASH       X_RB_0
    //  ├────────┤ ╰─────────────┼─────────────┴─────────────┼─────────────┼─────────────┤ ├────────┤ ├─────────────┼─────────────┼─────────────┴───────────────────────────╯ ├────────┤
          X_LH_0                                               BACKSPACE_NUM &lt SYM TAB     X_MH_0     &lt FN ENTER  SPACE_NAV                                                 X_RH_0
    //  ╰────────╯                                           ╰─────────────┴─────────────╯ ╰────────╯ ╰─────────────┴─────────────╯                                           ╰────────╯
)

ZMK_LAYER(aptmak,
    //  ╭────────╮ ╭─────────────┬─────────────┬─────────────┬─────────────┬─────────────╮ ╭────────╮ ╭─────────────┬─────────────┬─────────────┬─────────────┬─────────────╮ ╭────────╮
          X_LT_0     &kp X         &kp W         &kp F         &kp P         &kp B           X_MT_0     &kp Q         &kp L         &kp U         &kp Y         &kp SQT         X_RT_0
    //  ├────────┤ ├─────────────┼─────────────┼─────────────┼─────────────┼─────────────┤ ├────────┤ ├─────────────┼─────────────┼─────────────┼─────────────┼─────────────┤ ├────────┤
          X_LM_0     &hml LSHIFT R &hml LALT S   &hml LCTRL T  &hml LGUI H   &kp K           X_MM_0     &kp J         &hmr RGUI N   &hmr RCTRL A  &hmr RALT I   &hmr RSHIFT O   X_RM_0
    //  ├────────┤ ├─────────────┼─────────────┼─────────────┼─────────────┼─────────────┤ ├────────┤ ├─────────────┼─────────────┼─────────────┼─────────────┼─────────────┤ ├────────┤
          X_LB_0     &kp SEMICOLON &kp C         &kp G         &kp D         &kp V           X_MB_0     &kp Z         &kp M         &kp COMMA     &kp DOT       &kp SLASH       X_RB_0
    //  ├────────┤ ╰─────────────┼─────────────┴─────────────┼─────────────┼─────────────┤ ├────────┤ ├─────────────┼─────────────┼─────────────┴───────────────────────────╯ ├────────┤
          X_LH_0                                               BACKSPACE_NUM &lt SYM TAB     X_MH_0     &lt FN E      SPACE_NAV                                                 X_RH_0
    //  ╰────────╯                                           ╰─────────────┴─────────────╯ ╰────────╯ ╰─────────────┴─────────────╯                                           ╰────────╯
)

ZMK_LAYER(nav,
    //  ╭────────╮ ╭─────────────┬─────────────┬─────────────┬─────────────┬─────────────╮ ╭────────╮ ╭─────────────┬─────────────┬─────────────┬─────────────┬─────────────╮ ╭────────╮
          X_LT_1     ___           ___           ___           ___           ___             X_MT_1     ___           ___           ___           ___           ___             X_RT_1
    //  ├────────┤ ├─────────────┼─────────────┼─────────────┼─────────────┼─────────────┤ ├────────┤ ├─────────────┼─────────────┼─────────────┼─────────────┼─────────────┤ ├────────┤
          X_LM_1     &kp LSHIFT    &kp LALT      &kp LCTRL     &kp LGUI      ___             X_MM_1     &kp LEFT      &kp DOWN      &kp UP        &kp RIGHT     ___             X_RM_1
    //  ├────────┤ ├─────────────┼─────────────┼─────────────┼─────────────┼─────────────┤ ├────────┤ ├─────────────┼─────────────┼─────────────┼─────────────┼─────────────┤ ├────────┤
          X_LB_1     ___           ___           ___           ___           ___             X_MB_1     &kp HOME      &kp PG_DN     &kp PG_UP     &kp END       ___             X_RB_1
    //  ├────────┤ ╰─────────────┼─────────────┴─────────────┼─────────────┼─────────────┤ ├────────┤ ├─────────────┼─────────────┼─────────────┴───────────────────────────╯ ├────────┤
          X_LH_1                                               ___           ___             X_MH_1     ___           ___                                                       X_RH_1
    //  ╰────────╯                                           ╰─────────────┴─────────────╯ ╰────────╯ ╰─────────────┴─────────────╯                                           ╰────────╯
)

ZMK_LAYER(num,
    //  ╭────────╮ ╭─────────────┬─────────────┬─────────────┬─────────────┬─────────────╮ ╭────────╮ ╭─────────────┬─────────────┬─────────────┬─────────────┬─────────────╮ ╭────────╮
          X_LT_2     &kp N1        &kp N2        &kp N3        &kp N4        &kp N5          X_MT_2     &kp N6        &kp N7        &kp N8        &kp N9        &kp N0          X_RT_2
    //  ├────────┤ ├─────────────┼─────────────┼─────────────┼─────────────┼─────────────┤ ├────────┤ ├─────────────┼─────────────┼─────────────┼─────────────┼─────────────┤ ├────────┤
          X_LM_2     &kp LSHIFT    &kp LALT      &kp LCTRL     &kp RGUI      ___             X_MM_2     &kp MINUS     &kp EQUAL     ___           ___           &kp SEMICOLON   X_RM_2
    //  ├────────┤ ├─────────────┼─────────────┼─────────────┼─────────────┼─────────────┤ ├────────┤ ├─────────────┼─────────────┼─────────────┼─────────────┼─────────────┤ ├────────┤
          X_LB_2     ___           ___           ___           ___           ___             X_MB_2     &kp COLON     &kp PLUS      ___           ___           ___             X_RB_2
    //  ├────────┤ ╰─────────────┼─────────────┴─────────────┼─────────────┼─────────────┤ ├────────┤ ├─────────────┼─────────────┼─────────────┴───────────────────────────╯ ├────────┤
          X_LH_2                                               ___           ___             X_MH_2     ___           ___                                                       X_RH_2
    //  ╰────────╯                                           ╰─────────────┴─────────────╯ ╰────────╯ ╰─────────────┴─────────────╯                                           ╰────────╯
)

ZMK_LAYER(sym,
    //  ╭────────╮ ╭─────────────┬─────────────┬─────────────┬─────────────┬─────────────╮ ╭────────╮ ╭─────────────┬─────────────┬─────────────┬─────────────┬─────────────╮ ╭────────╮
          X_LT_3     &kp EXCL      &kp AT        &kp HASH      &kp DOLLAR    &kp PERCENT     X_MT_3     &kp CARET     &kp AMPS      &kp ASTERISK  &kp LPAR      &kp RPAR        X_RT_3
    //  ├────────┤ ├─────────────┼─────────────┼─────────────┼─────────────┼─────────────┤ ├────────┤ ├─────────────┼─────────────┼─────────────┼─────────────┼─────────────┤ ├────────┤
          X_LM_3     &kp LSHIFT    &kp LALT      &kp LCTRL     &kp RGUI      ___             X_MM_3     &kp MINUS     &kp EQUAL     &kp LBKT      &kp RBKT      &kp SEMICOLON   X_RM_3
    //  ├────────┤ ├─────────────┼─────────────┼─────────────┼─────────────┼─────────────┤ ├────────┤ ├─────────────┼─────────────┼─────────────┼─────────────┼─────────────┤ ├────────┤
          X_LB_3     ___           ___           ___           ___           ___             X_MB_3     &kp COLON     &kp PLUS      &kp LBRC      &kp RBRC      &kp BACKSLASH   X_RB_3
    //  ├────────┤ ╰─────────────┼─────────────┴─────────────┼─────────────┼─────────────┤ ├────────┤ ├─────────────┼─────────────┼─────────────┴───────────────────────────╯ ├────────┤
          X_LH_3                                               ___           ___             X_MH_3     ___           ___                                                       X_RH_3
    //  ╰────────╯                                           ╰─────────────┴─────────────╯ ╰────────╯ ╰─────────────┴─────────────╯                                           ╰────────╯
)

ZMK_CONDITIONAL_LAYER(media, NAV NUM, MEDIA)  // NAV + NUM -->s MEDIA

ZMK_LAYER(media,
    //  ╭────────╮ ╭─────────────┬─────────────┬─────────────┬─────────────┬─────────────╮ ╭────────╮ ╭─────────────┬─────────────┬─────────────┬─────────────┬─────────────╮ ╭────────╮
          X_LT_4     ___           ___           ___           ___           ___             X_MT_4     ___           ___           ___           ___           &kp C_PREV      X_RT_4
    //  ├────────┤ ├─────────────┼─────────────┼─────────────┼─────────────┼─────────────┤ ├────────┤ ├─────────────┼─────────────┼─────────────┼─────────────┼─────────────┤ ├────────┤
          X_LM_4     ___          &kp C_SNAPSHOT &kp C_BRI_UP  &kp C_BRI_DN  ___             X_MM_4     &kp C_PP      &kp C_VOL_DN  &kp C_VOL_UP  ___           ___             X_RM_4
    //  ├────────┤ ├─────────────┼─────────────┼─────────────┼─────────────┼─────────────┤ ├────────┤ ├─────────────┼─────────────┼─────────────┼─────────────┼─────────────┤ ├────────┤
          X_LB_4     ___           ___           &kp C_BRI_MIN &kp C_BRI_MAX ___             X_MB_4     &kp C_NEXT    &kp C_MUTE    ___           ___           ___             X_RB_4
    //  ├────────┤ ╰─────────────┼─────────────┴─────────────┼─────────────┼─────────────┤ ├────────┤ ├─────────────┼─────────────┼─────────────┴───────────────────────────╯ ├────────┤
          X_LH_4                                               ___           ___             X_MH_4     ___           ___                                                       X_RH_4
    //  ╰────────╯                                           ╰─────────────┴─────────────╯ ╰────────╯ ╰─────────────┴─────────────╯                                           ╰────────╯
)

ZMK_LAYER(mouse,
    //  ╭────────╮ ╭─────────────┬─────────────┬─────────────┬─────────────┬─────────────╮ ╭────────╮ ╭─────────────┬─────────────┬─────────────┬─────────────┬─────────────╮ ╭────────╮
          X_LT_5     ___           ___           ___           ___           ___             X_MT_5     U_WH_L        U_WH_D        U_WH_U         U_WH_R       ___             X_RT_5
    //  ├────────┤ ├─────────────┼─────────────┼─────────────┼─────────────┼─────────────┤ ├────────┤ ├─────────────┼─────────────┼─────────────┼─────────────┼─────────────┤ ├────────┤
          X_LM_5     ___           ___           ___           ___           ___             X_MM_5     U_MS_L        U_MS_D        U_MS_U         U_MS_R       ___             X_RM_5
    //  ├────────┤ ├─────────────┼─────────────┼─────────────┼─────────────┼─────────────┤ ├────────┤ ├─────────────┼─────────────┼─────────────┼─────────────┼─────────────┤ ├────────┤
          X_LB_5     ___           ___           ___           ___           ___             X_MB_5     ___           &mkp MB4      &mkp MCLK      &mkp MB5     ___             X_RB_5
    //  ├────────┤ ╰─────────────┼─────────────┴─────────────┼─────────────┼─────────────┤ ├────────┤ ├─────────────┼─────────────┼─────────────┴───────────────────────────╯ ├────────┤
          X_LH_5                                               ___           ___             X_MH_5     &mkp LCLK     &mkp RCLK                                                 X_RH_5
    //  ╰────────╯                                           ╰─────────────┴─────────────╯ ╰────────╯ ╰─────────────┴─────────────╯                                           ╰────────╯
)

ZMK_LAYER(fn,
    //  ╭────────╮ ╭─────────────┬─────────────┬─────────────┬─────────────┬─────────────╮ ╭────────╮ ╭─────────────┬─────────────┬─────────────┬─────────────┬─────────────╮ ╭────────╮
          X_LT_6     &kp F1        &kp F2        &kp F3        &kp F4        &kp F5          X_MT_6     &kp F6        &kp F7        &kp F8        &kp F9        &kp F10         X_RT_6
    //  ├────────┤ ├─────────────┼─────────────┼─────────────┼─────────────┼─────────────┤ ├────────┤ ├─────────────┼─────────────┼─────────────┼─────────────┼─────────────┤ ├────────┤
          X_LM_6     XXX           XXX           XXX           XXX           XXX             X_MM_6     &kp F12       &kp F11       XXX           XXX           XXX             X_RM_6
    //  ├────────┤ ├─────────────┼─────────────┼─────────────┼─────────────┼─────────────┤ ├────────┤ ├─────────────┼─────────────┼─────────────┼─────────────┼─────────────┤ ├────────┤
          X_LB_6     XXX           XXX           XXX           XXX           XXX             X_MB_6     XXX           XXX           XXX           XXX           XXX             X_RB_6
    //  ├────────┤ ╰─────────────┼─────────────┴─────────────┼─────────────┼─────────────┤ ├────────┤ ├─────────────┼─────────────┼─────────────┴───────────────────────────╯ ├────────┤
          X_LH_6                                               XXX           XXX             X_MH_6     ___           XXX                                                       X_RH_6
    //  ╰────────╯                                           ╰─────────────┴─────────────╯ ╰────────╯ ╰─────────────┴─────────────╯                                           ╰────────╯
)

ZMK_LAYER(sys,
    //  ╭────────╮ ╭─────────────┬─────────────┬─────────────┬─────────────┬─────────────╮ ╭────────╮ ╭─────────────┬─────────────┬─────────────┬─────────────┬─────────────╮ ╭────────╮
          X_LT_7                                _BT_SEL_KEYS_                                X_MT_7     XXX           XXX           XXX           XXX           XXX             X_RT_7
    //  ├────────┤ ├─────────────┼─────────────┼─────────────┼─────────────┼─────────────┤ ├────────┤ ├─────────────┼─────────────┼─────────────┼─────────────┼─────────────┤ ├────────┤
          X_LM_7     XXX           XXX           XXX           XXX           XXX             X_MM_7     XXX           XXX           XXX           XXX           XXX             X_RM_7
    //  ├────────┤ ├─────────────┼─────────────┼─────────────┼─────────────┼─────────────┤ ├────────┤ ├─────────────┼─────────────┼─────────────┼─────────────┼─────────────┤ ├────────┤
          X_LB_7     XXX           XXX           XXX           XXX           XXX             X_MB_7     XXX           XXX           XXX           XXX           XXX             X_RB_7
    //  ├────────┤ ╰─────────────┼─────────────┴─────────────┼─────────────┼─────────────┤ ├────────┤ ├─────────────┼─────────────┼─────────────┴───────────────────────────╯ ├────────┤
          X_LH_7                                               XXX           &bootloader     X_MH_7     &sys_reset    XXX                                                       X_RH_7
    //  ╰────────╯                                           ╰─────────────┴─────────────╯ ╰────────╯ ╰─────────────┴─────────────╯                                           ╰────────╯
)