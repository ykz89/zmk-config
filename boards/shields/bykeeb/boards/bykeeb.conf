## boards/shields/bykeeb/boards/bykeeb.conf
```kconfig
# For audio buzzer
CONFIG_PWM=y
# https://discord.com/channels/939959680611020840/1189280494001606657/1246715087549628417
CONFIG_PWM_INIT_PRIORITY=20
```

## boards/shields/testamatta_011/Kconfig.shield
```kconfig
# Copyright (c) 2020 ZMK Contributors
# SPDX-License-Identifier: MIT

config SHIELD_TESTAMATTA_011
    def_bool $(shields_list_contains,testamatta_011)
```

## config/boards/shields/skeletyl/Kconfig.defconfig
```kconfig
# Copyright (c) 2022 ZMK Contributors
# SPDX-License-Identifier: MIT

if SHIELD_SKELETYL_DONGLE

config ZMK_KEYBOARD_NAME
    default "Skeletyl"

config ZMK_SPLIT_ROLE_CENTRAL
    default y

config ZMK_USB
    default y

endif
 
if SHIELD_SKELETYL_LEFT

config ZMK_KEYBOARD_NAME
	default "Skeletyl Left"

endif

if SHIELD_SKELETYL_RIGHT

config ZMK_KEYBOARD_NAME
	default "Skeletyl Right"

endif

if SHIELD_SKELETYL_LEFT || SHIELD_SKELETYL_RIGHT || SHIELD_SKELETYL_DONGLE

config ZMK_SPLIT
	default y

config ZMK_BLE
    default y
	
endif
```

## config/boards/shields/testamatta_011/Kconfig.defconfig
```kconfig
# Copyright (c) 2022 ZMK Contributors
# SPDX-License-Identifier: MIT

if SHIELD_TESTAMATTA_011

config ZMK_KEYBOARD_NAME
	default "011 rev 2"

endif
```

## config/west.yml
```yaml
manifest:
  remotes:
    - name: badjeff
      url-base: https://github.com/badjeff
    - name: jawick
      url-base: https://github.com/JW2586/zmk.git
    - name: petejohanson
      url-base: https://github.com/petejohanson
    - name: sadekbaroudi
      url-base: https://github.com/sadekbaroudi
    - name: ykz89
      url-base: https://github.com/ykz89
    - name: zmkfirmware
      url-base: https://github.com/zmkfirmware  
  projects:
    - name: zmk
      remote: zmkfirmware
      revision: main
      import: app/west.yml
    - name: zmk-pmw3610-driver
      remote: badjeff
      revision: main
    - name: zmk-split-peripheral-input-relay
      remote: badjeff
      revision: main
    - name: zmk-input-behavior-listener
      remote: badjeff
      revision: main
    - name: zmk-fingerpunch-keyboards
      remote: sadekbaroudi
      revision: main
      import: config/deps.yml
    - name: chiptuner-zmk-module
      remote: petejohanson
      revision: main
  self:
    path: config
```
