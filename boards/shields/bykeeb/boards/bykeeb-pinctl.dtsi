/*
 * Copyright (c) 2025, ykz89
 * SPDX-License-Identifier: MIT
 */

#include <dt-bindings/pinctrl/rpi-pico-rp2040-pinctrl.h>

&pinctrl {
    // for audio buzzer
    pwm_ch1a_default: pwm_ch1a_default {
	    group1 {
		    pinmux = <PWM_1A_P2>;
	    };
    };
};